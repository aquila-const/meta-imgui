## conf/layer.conf
```bitbake
# We have a conf and classes directory, add to BBPATH
BBPATH .= ":${LAYERDIR}"

# We have recipes-* directories, add to BBFILES
BBFILES += "${LAYERDIR}/recipes-*/*/*.bb ${LAYERDIR}/recipes-*/*/*.bbappend"

BBFILE_COLLECTIONS += "noctogui"
BBFILE_PATTERN_noctogui = "^${LAYERDIR}/"

BBFILE_PRIORITY_noctogui = "99"

LAYERSERIES_COMPAT_noctogui = "dunfell"
```
